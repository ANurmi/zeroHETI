## zephyr/soc/sochub/zeroheti/Kconfig
```kconfig
# Copyright (c) 2023 Rivos Inc.
# SPDX-License-Identifier: Apache-2.0

config SOC_ZEROHETI
	select ATOMIC_OPERATIONS_C
	select INCLUDE_RESET_VECTOR
	select RISCV_ISA_RV32E
	select RISCV_ISA_EXT_M
	select RISCV_ISA_EXT_C
	select RISCV_ISA_EXT_ZICSR
	select RISCV
	select RISCV_PRIVILEGED
	select GEN_IRQ_VECTOR_TABLE
	select RISCV_HAS_CLIC
	select INTC_CLIC_ZEROHETI

config ZEROHETI_MTIME_PRESCALER
	int "mtime prescaler"
	depends on SOC_ZEROHETI
	default 0
	range 0 1023
	help
	  mtime advances once every (value + 1) CPU cycles.
```
