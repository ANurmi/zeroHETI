/*
 * Copyright (c) 2023 by Rivos Inc.
 *
 * SPDX-License-Identifier: Apache-2.0
 */

/dts-v1/;

#include <sochub/zeroheti.dtsi>

/ {
	model = "zeroHETI Board Description (hetiboard)";
	compatible = "sochub,hetiboard";

	chosen {
		zephyr,console = &uart0;
		zephyr,shell-uart = &uart0;
		zephyr,sram = &ram0;
		zephyr,flash = &flash0;
	};
};

&uart0 {
  compatible = "ns16550";
	status = "okay";
	clock-frequency = <125000>;
	current-speed = <7200>;
  reg-shift = <0>;
};

&mtimer {
	status = "okay";
};
